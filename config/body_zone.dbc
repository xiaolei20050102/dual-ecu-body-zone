VERSION ""

NS_ :

BS_:

BU_: S32K_ECU F411_ECU PC_TOOL

BO_ 256 BodyZoneStatus: 8 S32K_ECU
 SG_ SystemState : 0|8@1+ (1,0) [0|255] "" PC_TOOL,F411_ECU
 SG_ FaultLevel : 8|8@1+ (1,0) [0|255] "" PC_TOOL,F411_ECU

BO_ 512 ActuatorCommand: 8 S32K_ECU
 SG_ TargetPosition : 0|16@1+ (1,0) [0|65535] "" F411_ECU
 SG_ CommandEnable : 16|1@1+ (1,0) [0|1] "" F411_ECU

BO_ 768 ActuatorFeedback: 8 F411_ECU
 SG_ ActualPosition : 0|16@1+ (1,0) [0|65535] "" S32K_ECU,PC_TOOL
 SG_ LimitState : 16|2@1+ (1,0) [0|3] "" S32K_ECU,PC_TOOL
